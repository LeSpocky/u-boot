/*
 * at91-proficube.dts – Device Tree file for Thorsis Technologies ProfiCube board
 *
 * © 2025 Thorsis Technologies GmbH
 */
/dts-v1/;
#include "at91-proficube-common.dtsi"

&fpga {
	compatible = "altr,fpga-passive-serial";

	spi-max-frequency = <50000000>;
	enable-gpios = <&pioA PIN_PA19 GPIO_ACTIVE_LOW>;
	altr,size = <368011>;	// Altera_EP3C5_SIZE == ALTERA_EP4CE6_SIZE
};
